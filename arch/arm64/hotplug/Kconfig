## arch/arm64/hotplug/Kconfig
```kconfig
menu "Custom Hotplug drivers"

config CUSTOM_HOTPLUG
	bool "Enable custom hotplug support"

config MSM_HOTPLUG
        bool "MSM hotplug by [Fluxi]"
        depends on HOTPLUG_CPU
        default n
        help
          The MSM hotplug driver controls on-/offlining of additional cores bas$

config THUNDERPLUG_CONTROL
	bool "Thunderplug"
	depends on CUSTOM_HOTPLUG
	help
	  This driver hotplugs cpu cores based on per-core load

endmenu
```
